## config/boards/shields/pungo_split/Kconfig.defconfig
```kconfig
if SHIELD_PUNGO_SPLIT_LEFT
config ZMK_KEYBOARD_NAME
    default "PungoSplit"
config ZMK_SPLIT
    default y
config ZMK_SPLIT_ROLE_CENTRAL
    default y
endif

if SHIELD_PUNGO_SPLIT_RIGHT
config ZMK_SPLIT
    default y
config ZMK_SPLIT_ROLE_PERIPHERAL
    default y
endif
```

## config/boards/shields/pungo_split/Kconfig.shield
```kconfig
config SHIELD_PUNGO_SPLIT_LEFT
    def_bool $(shields_list_contains,pungo_split_left)

config SHIELD_PUNGO_SPLIT_RIGHT  
    def_bool $(shields_list_contains,pungo_split_right)
```
